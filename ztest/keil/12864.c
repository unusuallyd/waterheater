#include <reg52.h>
#define uchar unsigned char 
#define uint unsigned int



sbit   EN=P2^2;
sbit   RW=P2^1;
sbit   RS=P2^0;
sbit   ON=P2^1;

#define LCDb_BASCMD   0x30     // 基本指令集
#define LCDb_CLS   0x01     // 清屏
#define LCDb_HOME   0x02     // 地址返回原点，不改变DDRAM内容
#define LCDb_ENTRY   0x06     // 设定输入模式，光标加，屏幕不移动

#define LCDb_CURON     0x0E     // 显示光标
#define LCDb_CURFLA   0x0F     // 打开光标闪烁
#define LCDb_C2L   0x10     // 光标左移
#define LCDb_C2R   0x14     // 光标右移
#define LCDb_D2L   0x18     // 屏幕左移
#define LCDb_D2R   0x1C     // 屏幕又移
#define LCDb_ON     0x0C     // 打开显示
#define LCDb_OFF   0x08         // 关闭显示

#define LCDb_EXTCMD1   0x34     // 扩充指令集，关闭绘图显示
#define LCDb_EXTCMD2   0x36     // 扩充指令集，打开绘图显示
#define LCDb_EXTCLS   0x01     // 清屏
#define LCDb_REVL1   0x04     // 反显第1行
#define LCDb_REVL2   0x05     // 反显第2行
#define LCDb_REVL3   0x06     // 反显第3行
#define LCDb_REVL4   0x07     // 反显第4行
#define sleep   0x08     // 睡眠模式
#define Dissleep   0x08     // 脱离睡眠模式


#define E_set EN=1 //液晶使能
#define E_clear EN=0
#define RW_set RW=1 //液晶读写
#define RW_clear RW=0
#define RS_set RS=1 //液晶数据
#define RS_clear RS=0 //液晶指令
sbit beer=P2^0;
unsigned char j=0;

unsigned char yb=0x80;
unsigned char m=0; 
bit flagCom=0;
bit fbr=1;
unsigned char code name00[]={"飞射白鹿雪连天，"};
unsigned char code name01[]={"笑书神侠倚碧鸳。"};
unsigned char code name02[]={"自古英雄多奇逸，"};
unsigned char code name03[]={"金老挥毫尽使然。"};
unsigned char code name10[]={"李白乘舟将欲行，"};
unsigned char code name11[]={"忽闻岸上踏歌声。"};
unsigned char code name12[]={"桃花潭水深千尺，"};
unsigned char code name13[]={"不及汪伦送我情。"};
unsigned char code name20[]={"这是我的128*64液"};
unsigned char code name21[]={"晶显示测试程序，"};
unsigned char code name22[]={"welcome to commu"};
unsigned char code name23[]={"今天的实时温度："};
unsigned char code name24[]={"接收到串口信息："};
unsigned char code name25[]={"EEPROM读取中……"};
unsigned char code name26[]={"读取的EEPROM为："};
unsigned char gotmessage[48]={"                                                "};




unsigned char code tu1[]={
0x00,0x00,0x00,0x00,0x00,0x00,0x00,0x00,0x00,0x00,0x00,0x00,0x00,0x00,0x00,0x00,
0x00,0x00,0x00,0x00,0x00,0x00,0x00,0x00,0x00,0x00,0x00,0x00,0x00,0x00,0x00,0x00,
0x3F,0xFF,0xFF,0xFF,0xFF,0xFF,0xFF,0xFF,0xFF,0xFF,0xFF,0xFF,0xFF,0xFF,0xFF,0xFC,
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0x00,0x00,0x00,0x00,0x00,0x00,0x00,0x00,0x00,0x00,0x00,0x00,0x00,0x00,0x00,0x00,};


unsigned char code tu2[]={
0x00,0x00,0x00,0x00,0x00,0x00,0x00,0x00,0x00,0x00,0x00,0x00,0x00,0x00,0x00,0x00,
0x00,0x00,0x00,0x00,0x00,0x00,0x00,0x00,0x00,0x00,0x00,0x00,0x00,0x00,0x00,0x00,
0x00,0x30,0x00,0x00,0xC0,0x00,0x00,0x00,0x00,0x00,0x60,0x00,0x06,0x00,0x00,0x00,
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0x00,0x00,0x00,0x00,0x00,0x00,0x00,0x00,0x00,0x00,0x00,0x00,0x00,0x00,0x00,0x00,};

unsigned char code zi[]={"欢迎使用本产品，本系统是基于高科技产品。"
"系统具有四个双向口，输入输出电流大，防雷击，抗击打能力强，集成全球卫星定位系统"
"是一款不可多得的神奇产品。走路，千万不要错，就像一张张、一层层无形的网，无论你的人生是忙碌"
"的，还是快乐的。它总会在某个不经意间将你罩。要么冲破它，"
"要么被缠绕。人生难免寂寞。只能感悟。只有面对。"};

void delayms(unsigned int z)
{
	unsigned int x,y;
	for(x=z;x>0;x--)
		for(y=110;y>0;y--);
}
void delayus(unsigned int t)
{
	while(--t);

}




void wr_com(unsigned char value)//写指令，写指令时必须为RS=0;RW=0;
{
	E_clear;
	RS_clear;
	RW_clear;
	delayus(1);
	P0=value;
	E_set;
	delayus(10); //如果没有延时就必须要加查忙指令
	E_clear;
	delayus(1);
}
unsigned char rd_data(void)
{
   	unsigned char sj;
	P0=0xFF;
	E_clear;
	RS_set;
	RW_set;
	delayus(1);
	E_set;
	delayus(10);//如果没有延时就必须要加查忙指令
	sj=P0;
	E_clear;
	return sj;	
}
void wr_data(unsigned char sj)//写数据，写数据时必须为 RS=1;RW=0;
{

	E_clear;
	RS_set;
	RW_clear;
	delayus(1);
	P0=sj;
	E_set;
	delayus(10);//如果没有延时就必须要加查忙指令
	E_clear;
	delayus(1);
}
void WRDataXY(uchar x,uchar y, uchar Data,bit color)
{
	unsigned char tempL,tempH,temx,tem;
	//wr_com(0x34);
	//wr_com(0x36);	  //切换到扩展指令集并打开绘图模式
	
	temx=x;
	x=temx/4;


	if(color==0)
	Data=~Data;
	
	
	if( y >= 32 )
	{
        y=y-32;
        x=x+8;
    }

	wr_com(0x80|y);     //行位置
    wr_com(0x80|x);     //列位置
	rd_data();
	tempL=rd_data();
	tempH=rd_data();
	temx=temx%4;
	if(temx==0)
	 {  tem=(tempL&0x0F)|(Data<<4);
		tempL=tem;
	 }
	else if(temx==1)
	{
		tem=(tempL&0xF0)|(Data&0x0F);
		tempL=tem;
	}
  	else if(temx==2)
	{
		tem=(tempH&0x0F)|(Data<<4);
		tempH=tem;
	}		
	else
	{  
		tem=(tempH&0xF0)|(Data&0x0F);
		tempH=tem;
	}
	 //tempL=Data;

	 //tempH=Data;  
	   wr_com(0x80|y);     //行位置
       wr_com(0x80|x);     //列位置
	   wr_data(tempL);
	   wr_data(tempH);

	  //wr_com(0x30); //恢复至基本指令集
}
void reset (void)
{
	wr_com(0x30);//功能设置，一次送8位数据，基本指令集
	wr_com(0x0C);//0000,1100  整体显示，游标off，游标位置off
	wr_com(0x01);//0000,0001 清DDRAM   清屏
	wr_com(0x02);//0000,0010 DDRAM地址归位
	wr_com(0x80);//1000,0000 设定DDRAM 7位地址000，0000到地址计数器AC//     
	wr_com(0x04);//点设定，显示字符/光标从左到右移位，DDRAM地址加 一//   
	wr_com(0x0C);//显示设定，开显示，显示光标，当前显示位反白闪动
	wr_com(0x01);//清屏	   */
}
//****************
//outChinese 为函数名
//place 为显示地址的首地址
//unit 字符长度
//point 要显示数据的指针
void outChinese(unsigned char place,unsigned char unit,unsigned char *point)
{
	unsigned char i,progdata;
	wr_com(place);
	for(i=0;i<unit*2;i++)//一个汉字为两个字符
	{
	progdata=*(point+i);
	wr_data(progdata);
	}
}
void outchar(unsigned char place,unsigned char unit,unsigned char *point)
{
	unsigned char i,progdata;
	wr_com(place);
	for(i=0;i<unit;i++)
	{
		progdata=*(point+i);
		wr_data(progdata);
	}
}

//---------------------清屏函数(开机消除噪点)----------------------------//
//参数的使用说明：f=0时清屏；f=1时逐行清屏 
void GCCDRAMCL(bit f)
{
	uchar i,j;
	wr_com(0x34);
	if(f)
	wr_com(0x36);

	for(i=0;i<32;i++)            //12864实际为256x32
     {
         for(j=0;j<8;j++)				             //上半屏，
			{
			   wr_com(0x80|i);      //行位置
	           wr_com(0x80|j);      //列位置
			   wr_data(0x00);
			   wr_data(0x00);
		    }
        
     }
	 	for(i=0;i<32;i++)            //12864实际为256x32
     {
         for(j=8;j<16;j++)
			{										  //下半屏
			   wr_com(0x80|i);      //行位置
	           wr_com(0x80|j);      //列位置
			   wr_data(0x00);
			   wr_data(0x00);
		    }
        
     }
	wr_com(0x36); 
}
//---------------------清屏函数(开机消除噪点)----------------------------//


//---------------------画图函数----------------------------//
//参数的使用说明：
//                flag1=0时画面数据取反；flag1=1时画面数据不变 
//                flag2=0时动态逐行显示；flag2=1时整体显示 
//画图参数：      a1表示开始X地址(0-7) 
//                b1表示开始Y地址(0-127)
//				  a2表示结束X地址(0-7)
//				  b2表示结束Y地址(0-127)  
void huitu(bit flg1,bit flg2,uchar a1,uchar a2,uchar b1,uchar b2,unsigned char *puts)
{
     unsigned int x=0;
     unsigned char i,j;
     wr_com(0x34);      //8Bit扩充指令集,即使是36H也要写两次

	 if(flg2)
	  wr_com(0x36); 

	 //wr_com(0x01);//清屏

  if(b1<32&&b2<32)
  {
   
    for(i=b1;i<b2+1;i++)            ////行地址计数
     {							 //列地址计数

           for(j=a1;j<a2+1;j++)
			  {
			   wr_com(0x80|i);      //输入行地址
	           wr_com(0x80|j);      //输入列地址
			   if(flg1)
			    { wr_data(puts[x++]); //输入高位字节数据
			      wr_data(puts[x++]);  //输入低位字节数据
				}
				else
				{
				  wr_data(~puts[x++]);
			      wr_data(~puts[x++]);
				}
			  }
        
     }
  }
  else if(b1<32&&b2>31)
  {
	   for(i=b1;i<32;i++)            ////行地址计数
     {							 //列地址计数

           for(j=a1;j<a2+1;j++)		   //上半屏
			  {
			   wr_com(0x80|i);      //输入行地址
	           wr_com(0x80|j);      //输入列地址
			   if(flg1)
			    { wr_data(puts[x++]); //输入高位字节数据
			      wr_data(puts[x++]);  //输入低位字节数据
				}
				else
				{
				  wr_data(~puts[x++]);
			      wr_data(~puts[x++]);
				}
			  }
        
     }
	   for(i=0;i<b2-31;i++)            //12864实际为256x32
     {								   //下半屏
           for(j=8+a1;j<a2+9;j++)
			  {
			   wr_com(0x80|i);      //行位置
	           wr_com(0x80|j);      //列位置
			   if(flg1)
			    { wr_data(puts[x++]);
			      wr_data(puts[x++]);
				}
				else
				{
				  wr_data(~puts[x++]);
			      wr_data(~puts[x++]);
				}
			  }
     
     }
  }
  else if(b1>31&&b2>31)
  {
	   for(i=b1-31;i<b2-31;i++)            //
     {
           for(j=8+a1;j<a2+9;j++)
			  {
			   wr_com(0x80|i);      //行位置
	           wr_com(0x80|j);      //列位置
			   if(flg1)
			    { wr_data(puts[x++]);
			      wr_data(puts[x++]);
				}
				else
				{
				  wr_data(~puts[x++]);
			      wr_data(~puts[x++]);
				}
			  }
     
     }  
  
  }


	 wr_com(0x36);      //绘图ON,基本指令集里面36H不能开绘图
	 wr_com(0x30); //恢复至基本指令集	
}
//---------------------画图函数 end----------------------------//

void initUart(void)
{
	 TMOD|=0x20;
	 SCON=0x50;
	 PCON|=0x80;
	 TH1=0xfd;
	 TL1=0xfd;
	 TR1=1;
	 ES=1;
	 EA=1;
}

void ydgb(void)
{
	wr_com(yb);//显示光标位置
	yb=yb+0x01;
	if(yb==0x88){yb=0x90;}
	if(yb==0x97){yb=0x88;}
	if(yb==0x8f){yb=0x98;}
	if(yb==0xa0){yb=0x80;}
}



void WRData(uchar x,uchar y, LData,HData)
{
	wr_com(0x36);	  //切换到扩展指令集并打开绘图模式
	if(y<32)
	{
 				           //上半屏，
	   wr_com(0x80|y);     //行位置
       wr_com(0x80|x);     //列位置
	   wr_data(LData);
	   wr_data(HData);
	 }
	 if(y>=32)
	 	
     {
								//下半屏
	   wr_com(0x80|(y-32));     //行位置
       wr_com(0x80|(x+8));      //列位置
	   wr_data(LData);
	   wr_data(HData);
     }
	  wr_com(0x30); //恢复至基本指令集
}
void donghua()
{
     uchar i,temp,j,k;
	

	 huitu(1,1,0,7,0,63,tu1);
	 beer=0;
	 delayms(1000);
	  wr_com(0x36);
	 beer=1;
	 temp=0;
	 for(i=0;i<8;i++)
	 {
		 temp=temp|(1<<(7-i));
         for(k=38;k<42;k++)
		 WRData(0,k,0x22,temp);
		 delayms(20);
		
	 }
	 for(i=1;i<7;i++)
	{
		 temp=0;	
		 for(j=0;j<8;j++)
	     {
			temp=temp|(1<<(7-j));
			for(k=38;k<42;k++)
			WRData(i,k,temp,0x00);
			delayms(20);
	 	 }
		temp=0;	
		 for(j=0;j<8;j++)
	     {	
			temp=temp|(1<<(7-j));
			for(k=38;k<42;k++)
			WRData(i,k,0xFF,temp);
			delayms(20);	
		 }
		    
	 }
		  temp=0;	
		  for(j=0;j<8;j++)
	    {	
			temp=temp|(1<<(7-j));
			for(k=38;k<42;k++)
			WRData(7,k,temp,0x44);
	    	delayms(20);
		 }

	 
	   	wr_com(0x30); //恢复至基本指令集			
}

//写一页子程序
void write_page(unsigned int t, unsigned char *point)
{
    unsigned int m,n,i; 
	t+=1;     
  	for(m=0;m<5*64;m+=64)
	{	
		n=t;
		if(flagCom) break;
		wr_com(0x01);
		outChinese(0x80,8,point+m);   //第一行：80-87H
		outChinese(0x90,8,point+16+m);//第二行：90-97H
		outChinese(0x88,8,point+32+m);//第三行：88-8FH
		outChinese(0x98,8,point+48+m);//第四行：98-9FH
		
		while(n--)
		{ 
		  for(i=0;i<100;i++)
		  if(flagCom) break;
		  if(flagCom) break;
		}
	
		
	 }
	
   
}
void SendRS232(uchar t)
{
	SBUF=t;
	while(!TI);	
	TI=0;
}

void main(void)
{

	initUart();
	reset();
	GCCDRAMCL(1);
	donghua();
   	huitu(1,0,0,7,0,63,tu2);
    delayms(2000);
	wr_com(0x01);
	wr_com(0x30);

     while(1)
   {
       	outChinese(0x90,8,"仿真模型测试演示");//第二行：90-97H
		delayms(1000);
		write_page(10000,zi);
   	}


}

